/ {
    chosen {
        zmk,underglow = &led_strip;
    };

    led_strip: led_strip {
        compatible = "ws2812-strip";
        /*
         * You need to adjust the pin based on your wiring.
         * D1 on nice!nano v2 is P0.06
         * D4 on nice!nano v2 is P0.22
         */
        gpio-controller = <&gpio0>;
        data-gpios = <&gpio0 22 GPIO_ACTIVE_HIGH>; // P0.22


        // Total number of LEDs in your strip(s).
        // For Lily58, typically 6 per half for underglow (12 total for a split setup).
        // Adjust this number based on your actual LED count.
        chain-length = <6>;
    };
};
